## boards/shields/ec-test/Kconfig.defconfig
```kconfig
if SHIELD_EC-TEST_R

config ZMK_KEYBOARD_NAME
    default "ec-test Keyboard"

config ZMK_SPLIT_ROLE_CENTRAL
    default y

endif

if SHIELD_EC-TEST_LEFT || SHIELD_EC-TEST_RIGHT

config ZMK_SPLIT
    default y

endif
```

## boards/shields/ec-test/Kconfig.shield
```kconfig
config SHIELD_ECTEST_R
    def_bool $(shields_list_contains,ec-test_r)

config SHIELD_ECTEST_L
    def_bool $(shields_list_contains,ec-test_l)
```

## config/west.yml
```yaml
manifest:
  remotes:
    - name: zmkfirmware
      url-base: https://github.com/zmkfirmware
    - name: KATATHY-ZMK
      url-base: https://github.com/KATACY-ZMK

  projects:
    - name: zmk
      remote: zmkfirmware
      revision: main
      import: app/west.yml

  self:
    path: config
```
