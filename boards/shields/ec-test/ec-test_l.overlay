#include "ec-test.dtsi"

&kscan0 {
    col-gpios
        = <&xiao_d 8 GPIO_ACTIVE_HIGH>
        , <&xiao_d 7 GPIO_ACTIVE_HIGH>
        ;
};

&left1_encoder {
   status = "disabled";
};

&left2_encoder {
   status = "okay";
};